## Kconfig
```kconfig
# Copyright (c) 2025 Subbotin N.Y. <neymarus@yandex.ru>
# GitHub: https://github.com/nktsb
# SPDX-License-Identifier: Apache-2.0

menuconfig LTR390
	bool "LTR390 optical sensor"
	default y
	depends on DT_HAS_LITEON_LTR390_ENABLED
	select I2C
	help
	  Enable driver for LTR390 sensor.
```

## dts/bindings/ltr390/liteon,ltr390.yaml
```yaml
# SPDX-License-Identifier: Apache-2.0

description: Liteon electronics LTR390 optical sensor over I2C

compatible: "liteon,ltr390"

include: [sensor-device.yaml, i2c-device.yaml]

properties:
  gain:
    type: int
    default: 3
    description: Sensor ADC measurement gain
    enum:
      - 1
      - 3
      - 6
      - 9
      - 18

  data-rate:
    type: int
    default: 100
    description: Data rate in ms
    enum:
      - 25
      - 50
      - 100
      - 200
      - 500
      - 1000
      - 2000

  resolution:
    type: int
    default: 16
    description: Data rate in ms
    enum:
      - 13
      - 16
      - 17
      - 18
      - 19
      - 20
  
  mode:
    type: string
    default: "ambient-light"
    enum:
      - "ambient-light"
      - "uv-index"
```
